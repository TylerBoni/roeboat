## idf/sdkconfig.defaults
```kconfig
# Serial console baud rate
CONFIG_ESP_CONSOLE_UART_BAUDRATE=115200

# Enable FreeRTOS stats formatting functions
CONFIG_FREERTOS_USE_TRACE_FACILITY=y
CONFIG_FREERTOS_USE_STATS_FORMATTING_FUNCTIONS=y

# Increase TCP/IP stack buffer sizes
CONFIG_LWIP_TCP_SND_BUF_DEFAULT=4096
CONFIG_LWIP_TCP_WND_DEFAULT=4096

# WiFi configuration
CONFIG_WIFI_SSID="RoeBoat-AP"
CONFIG_WIFI_PASSWORD="roeboat123"
CONFIG_WIFI_CHANNEL=1
CONFIG_WIFI_MAX_STA_CONN=4

# Enable warnings and set optimization level
CONFIG_COMPILER_OPTIMIZATION_DEBUG=y
CONFIG_COMPILER_WARN_WRITE_STRINGS=y 
```
